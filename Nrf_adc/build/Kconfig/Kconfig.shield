## Nrf_adc/build/Kconfig/Kconfig.shield
```kconfig
osource "c:/nordic/bt-fund/lesson4/blefund_less4_exer1/boards/shields/*/Kconfig.shield"
osource "C:/ncs/v2.4.2/nrf/boards/shields/*/Kconfig.shield"
```

## Nrf_adc/build/Kconfig/Kconfig.shield.defconfig
```kconfig
osource "c:/nordic/bt-fund/lesson4/blefund_less4_exer1/boards/shields/*/Kconfig.defconfig"
osource "C:/ncs/v2.4.2/nrf/boards/shields/*/Kconfig.defconfig"
```
